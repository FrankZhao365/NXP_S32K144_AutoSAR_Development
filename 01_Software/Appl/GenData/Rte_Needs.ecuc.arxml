AUTOSAR XML (schema 4-0-3)
package /DaVinci_Project
  module config Rte
    6 x RteBswModuleInstance:
      BswM
        BswM_MainFunctionTimingEvent0 (RteBswEventToTaskMapping): RteBswUsedOsEventRef=Rte_Ev_Cyclic2_OsTask_BSW_SCHM_0_10ms, RteBswUsedOsAlarmRef=Os/Rte_Al_TE2_OsTask_BSW_SCHM_0_10ms
      Det
      Dio
      EcuM
        EcuM_MainFunctionTimingEvent0 (RteBswEventToTaskMapping): RteBswUsedOsEventRef=Rte_Ev_Cyclic2_OsTask_BSW_SCHM_0_10ms, RteBswUsedOsAlarmRef=Os/Rte_Al_TE2_OsTask_BSW_SCHM_0_10ms
      Mcu
      Port
    5 x RteSwComponentInstance:
      BswM_EcuSwComposition
        Timer_BswM_MainFunction (RteEventToTaskMapping): RteUsedOsEventRef=Rte_Ev_Cyclic2_OsTask_BSW_SCHM_0_10ms, RteUsedOsAlarmRef=Os/Rte_Al_TE2_OsTask_BSW_SCHM_0_10ms
      Ct_LedCtrl_EcuSwComposition
        TMT_LedCtrl_Runnable (RteEventToTaskMapping): RteUsedOsEventRef=Rte_Ev_Run_Ct_LedCtrl_LedCtrl_Runnable, RteUsedOsAlarmRef=Os/Rte_Al_TE_Ct_LedCtrl_LedCtrl_Runnable
      Det_EcuSwComposition
      EcuM_EcuSwComposition
        Timer_EcuM_MainFunction (RteEventToTaskMapping): RteUsedOsEventRef=Rte_Ev_Cyclic2_OsTask_BSW_SCHM_0_10ms, RteUsedOsAlarmRef=Os/Rte_Al_TE2_OsTask_BSW_SCHM_0_10ms
      Os_OsCore0_swc_EcuSwComposition
    RteOsInteraction
      Rte_Al_TE_Ct_LedCtrl_LedCtrl_Runnable (RteUsedOsActivation): RteExpectedActivationOffset=0, RteActivationOsAlarmRef=Os/Rte_Al_TE_Ct_LedCtrl_LedCtrl_Runnable, RteActivationOsTaskRef=OsTask_APP
      Rte_Al_TE2_OsTask_BSW_SCHM_0_10ms (RteUsedOsActivation): RteExpectedActivationOffset=0, RteActivationOsAlarmRef=Os/Rte_Al_TE2_OsTask_BSW_SCHM_0_10ms, RteActivationOsTaskRef=OsTask_BSW_SCHM
  module config NvM
  module config Os
    OsTask_APP (OsTask): OsTaskActivation=1, OsTaskPriority=15, OsTaskSchedule=NON, OsTaskEventRef=Rte_Ev_Run_Ct_LedCtrl_LedCtrl_Runnable
    Rte_Al_TE_Ct_LedCtrl_LedCtrl_Runnable (OsAlarm): OsAlarmCounterRef=SystemTimer
      OsAlarmAction
        OsAlarmSetEvent: OsAlarmSetEventRef=Rte_Ev_Run_Ct_LedCtrl_LedCtrl_Runnable, OsAlarmSetEventTaskRef=OsTask_APP
    OsTask_BSW_SCHM (OsTask): OsTaskActivation=1, OsTaskPriority=0, OsTaskSchedule=NON, OsTaskEventRef=Rte_Ev_Cyclic2_OsTask_BSW_SCHM_0_10ms
    Rte_Al_TE2_OsTask_BSW_SCHM_0_10ms (OsAlarm): OsAlarmCounterRef=SystemTimer
      OsAlarmAction
        OsAlarmSetEvent: OsAlarmSetEventRef=Rte_Ev_Cyclic2_OsTask_BSW_SCHM_0_10ms, OsAlarmSetEventTaskRef=OsTask_BSW_SCHM
    Rte_Ev_Cyclic2_OsTask_BSW_SCHM_0_10ms (OsEvent)
    Rte_Ev_Run_Ct_LedCtrl_LedCtrl_Runnable (OsEvent)
  module config EcuC
  ecuc value collection DaVinci_Project: ecuc-values=[Com, Rte, Os, EcuC, NvM]
