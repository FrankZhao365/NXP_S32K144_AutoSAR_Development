AUTOSAR XML (schema 4-0-3)
package /DaVinci_Project
  module config Rte
    12 x RteBswModuleInstance:
      BswM
        BswM_MainFunctionTimingEvent0 (RteBswEventToTaskMapping): RteBswUsedOsEventRef=Rte_Ev_Cyclic2_OsTask_BSW_SCHM_0_10ms, RteBswUsedOsAlarmRef=Os/Rte_Al_TE2_OsTask_BSW_SCHM_0_10ms
      Can
        3 x RteBswEventToTaskMapping, all with RteBswUsedOsEventRef=Rte_Ev_Cyclic2_OsTask_BSW_SCHM_0_10ms, RteBswUsedOsAlarmRef=Os/Rte_Al_TE2_OsTask_BSW_SCHM_0_10ms:
          Can_MainFunction_BusOffTimingEvent0
          Can_MainFunction_ModeTimingEvent0
          Can_MainFunction_WakeupTimingEvent0
      CanIf
      CanSM
        CanSM_MainFunctionTimingEvent0 (RteBswEventToTaskMapping): RteBswUsedOsEventRef=Rte_Ev_Cyclic2_OsTask_BSW_SCHM_0_10ms, RteBswUsedOsAlarmRef=Os/Rte_Al_TE2_OsTask_BSW_SCHM_0_10ms
      Com
        Com_MainFunctionRxTimingEvent0 (RteBswEventToTaskMapping): RteBswUsedOsEventRef=Rte_Ev_Cyclic2_OsTask_BSW_SCHM_0_10ms, RteBswUsedOsAlarmRef=Os/Rte_Al_TE2_OsTask_BSW_SCHM_0_10ms
        Com_MainFunctionTxTimingEvent0 (RteBswEventToTaskMapping): RteBswUsedOsEventRef=Rte_Ev_Cyclic2_OsTask_BSW_SCHM_0_10ms, RteBswUsedOsAlarmRef=Os/Rte_Al_TE2_OsTask_BSW_SCHM_0_10ms
      ComM
        ComM_MainFunction_0TimingEvent0 (RteBswEventToTaskMapping): RteBswUsedOsEventRef=Rte_Ev_Cyclic2_OsTask_BSW_SCHM_0_20ms, RteBswUsedOsAlarmRef=Os/Rte_Al_TE2_OsTask_BSW_SCHM_0_20ms
      Det
      Dio
      EcuM
        EcuM_MainFunctionTimingEvent0 (RteBswEventToTaskMapping): RteBswUsedOsEventRef=Rte_Ev_Cyclic2_OsTask_BSW_SCHM_0_10ms, RteBswUsedOsAlarmRef=Os/Rte_Al_TE2_OsTask_BSW_SCHM_0_10ms
      Mcu
      PduR
      Port
    6 x RteSwComponentInstance:
      BswM_EcuSwComposition
        Timer_BswM_MainFunction (RteEventToTaskMapping): RteUsedOsEventRef=Rte_Ev_Cyclic2_OsTask_BSW_SCHM_0_10ms, RteUsedOsAlarmRef=Os/Rte_Al_TE2_OsTask_BSW_SCHM_0_10ms
      ComM_EcuSwComposition
        Timer_ComM_MainFunction_0 (RteEventToTaskMapping): RteUsedOsEventRef=Rte_Ev_Cyclic2_OsTask_BSW_SCHM_0_20ms, RteUsedOsAlarmRef=Os/Rte_Al_TE2_OsTask_BSW_SCHM_0_20ms
      Ct_LedCtrl_EcuSwComposition
        TMT_LedCtrl_Runnable (RteEventToTaskMapping): RteUsedOsEventRef=Rte_Ev_Run_Ct_LedCtrl_LedCtrl_Runnable, RteUsedOsAlarmRef=Os/Rte_Al_TE_Ct_LedCtrl_LedCtrl_Runnable
      Det_EcuSwComposition
      EcuM_EcuSwComposition
        Timer_EcuM_MainFunction (RteEventToTaskMapping): RteUsedOsEventRef=Rte_Ev_Cyclic2_OsTask_BSW_SCHM_0_10ms, RteUsedOsAlarmRef=Os/Rte_Al_TE2_OsTask_BSW_SCHM_0_10ms
      Os_OsCore0_swc_EcuSwComposition
    RteOsInteraction
      3 x RteUsedOsActivation, all with RteExpectedActivationOffset=0:
        Rte_Al_TE_Ct_LedCtrl_LedCtrl_Runnable: RteActivationOsAlarmRef=Os/Rte_Al_TE_Ct_LedCtrl_LedCtrl_Runnable, RteActivationOsTaskRef=OsTask_APP
        Rte_Al_TE2_OsTask_BSW_SCHM_0_10ms: RteActivationOsAlarmRef=Os/Rte_Al_TE2_OsTask_BSW_SCHM_0_10ms, RteActivationOsTaskRef=OsTask_BSW_SCHM
        Rte_Al_TE2_OsTask_BSW_SCHM_0_20ms: RteActivationOsAlarmRef=Os/Rte_Al_TE2_OsTask_BSW_SCHM_0_20ms, RteActivationOsTaskRef=OsTask_BSW_SCHM
  module config NvM
  module config Os
    OsTask_APP (OsTask): OsTaskActivation=1, OsTaskPriority=15, OsTaskSchedule=NON, OsTaskEventRef=Rte_Ev_Run_Ct_LedCtrl_LedCtrl_Runnable
    Rte_Al_TE_Ct_LedCtrl_LedCtrl_Runnable (OsAlarm): OsAlarmCounterRef=SystemTimer
      OsAlarmAction
        OsAlarmSetEvent: OsAlarmSetEventRef=Rte_Ev_Run_Ct_LedCtrl_LedCtrl_Runnable, OsAlarmSetEventTaskRef=OsTask_APP
    OsTask_BSW_SCHM (OsTask):
      OsTaskActivation = 1
      OsTaskPriority = 0
      OsTaskSchedule = NON
      OsTaskEventRef = Rte_Ev_Cyclic2_OsTask_BSW_SCHM_0_10ms
      OsTaskEventRef = Rte_Ev_Cyclic2_OsTask_BSW_SCHM_0_20ms
    Rte_Al_TE2_OsTask_BSW_SCHM_0_10ms (OsAlarm): OsAlarmCounterRef=SystemTimer
      OsAlarmAction
        OsAlarmSetEvent: OsAlarmSetEventRef=Rte_Ev_Cyclic2_OsTask_BSW_SCHM_0_10ms, OsAlarmSetEventTaskRef=OsTask_BSW_SCHM
    Rte_Al_TE2_OsTask_BSW_SCHM_0_20ms (OsAlarm): OsAlarmCounterRef=SystemTimer
      OsAlarmAction
        OsAlarmSetEvent: OsAlarmSetEventRef=Rte_Ev_Cyclic2_OsTask_BSW_SCHM_0_20ms, OsAlarmSetEventTaskRef=OsTask_BSW_SCHM
    3 x OsEvent:
      Rte_Ev_Cyclic2_OsTask_BSW_SCHM_0_10ms
      Rte_Ev_Cyclic2_OsTask_BSW_SCHM_0_20ms
      Rte_Ev_Run_Ct_LedCtrl_LedCtrl_Runnable
  module config EcuC
  ecuc value collection DaVinci_Project: ecuc-values=[Com, Rte, Os, EcuC, NvM]
