AUTOSAR XML (schema 00045)
package /Port
  module config Port: implementation-config-variant=VARIANT-POST-BUILD, module-description=Port_Impl
    CommonPublishedInformation:
      ArReleaseMajorVersion = 4
      ArReleaseMinorVersion = 2
      ArReleaseRevisionVersion = 2
      ModuleId = 124
      SwMajorVersion = 1
      SwMinorVersion = 0
      SwPatchVersion = 1
      VendorId = 43
    PortConfigSet
      NotUsedPortPin: PortPinDSE=Low_Drive_Strength, PortPinDirection=PORT_PIN_IN, PortPinLevelValue=PORT_PIN_LEVEL_LOW, PortPinPE=PullDisabled, PortPinPS=PullDown
      PortContainer_JTAG (PortContainer): PortNumberOfPortPins=4
        4 x PortPin, all with PortPinDSE=Low_drive_strength, PortPinDirectionChangeable=true, PortPinInitialMode=PORT_GPIO_MODE, PortPinLevelValue=PORT_PIN_LEVEL_LOW, PortPinModeChangeable=true, PortPinPFE=false:
          PortPin_JTAG_TCLK_PTC4: PortPinDirection=PORT_PIN_IN, PortPinId=7, PortPinMode=JTAG_TCLK_SWD_CLK, PortPinPE=PullEnabled, PortPinPS=PullUp, PortPinPcr=68
          PortPin_JTAG_TDI_PTC5: PortPinDirection=PORT_PIN_IN, PortPinId=5, PortPinMode=JTAG_TDI, PortPinPE=PullEnabled, PortPinPS=PullUp, PortPinPcr=69
          PortPin_JTAG_TDO_PTA10: PortPinDirection=PORT_PIN_OUT, PortPinId=8, PortPinMode=JTAG_TDO, PortPinPE=PullDisabled, PortPinPS=PullDown, PortPinPcr=10
          PortPin_JTAG_TMS_PTA4: PortPinDirection=PORT_PIN_IN, PortPinId=6, PortPinMode=JTAG_TMS_SWD_DIO, PortPinPE=PullEnabled, PortPinPS=PullUp, PortPinPcr=4
      PortContainer_LED (PortContainer): PortNumberOfPortPins=4
        4 x PortPin, all with PortPinDSE=Low_drive_strength, PortPinDirection=PORT_PIN_OUT, PortPinDirectionChangeable=true, PortPinInitialMode=PORT_GPIO_MODE, PortPinLevelValue=PORT_PIN_LEVEL_LOW, PortPinMode=GPIO, PortPinModeChangeable=true, PortPinPE=PullDisabled, PortPinPFE=false, PortPinPS=PullDown:
          PortPin_LEDB_4_PTD0_P4: PortPinId=1, PortPinPcr=96
          PortPin_LEDG_1_PTD16_P21: PortPinId=4, PortPinPcr=112
          PortPin_LEDR_2_PTD15_P22: PortPinId=3, PortPinPcr=111
          PortPin_LEDY_3_PTD1_P3: PortPinId=2, PortPinPcr=97
    PortGeneral:
      PortDevErrorDetect = true
      PortEnableUserModeSupport = false
      PortSet2PinsDirectionApi = false
      PortSetPinDirectionApi = true
      PortSetPinModeApi = true
      PortSetPinModeDoesNotTouchGpioLevel = false
      PortVersionInfoApi = true
