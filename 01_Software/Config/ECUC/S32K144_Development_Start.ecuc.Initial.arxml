AUTOSAR XML (schema 00045)
package /InitialEcuC
  ecuc value collection InitialEcuC
