AUTOSAR XML (schema 4-2-1)
package /ActiveEcuC
  ecuc value collection ActiveEcuC: ecu-extract=SYSTEM, ecuc-values=[Base, Resource, Mcu, Dio, Port, vSet, BswM, Det, EcuM, Os, Rte, EcuC, Com, PduR, CanSM, Can, CanIf, ComM]
