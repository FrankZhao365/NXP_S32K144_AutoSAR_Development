AUTOSAR XML (schema 00045)
package /ActiveEcuC
  ecuc value collection ActiveEcuC: ecu-extract=SYSTEM, ecuc-values=[Base, Resource, Mcu, Dio, Port, vSet, BswM, Det, EcuM, Os, Rte, EcuC]
