AUTOSAR XML (schema 4-2-1)
package /ActiveEcuC
  module config vSet: implementation-config-variant=VARIANT-PRE-COMPILE, module-description=vSet_Impl
    vSetGeneral: vSetDummyStatementKind=SelfAssignment
    vSetPlatform:
      vSetSizeOfROMPointer = Size32Bit
      vSetSizeOfRAMPointer = Size32Bit
      vSetByteOrder = LITTLE_ENDIAN
      vSetBitOrder = LSB_to_MSB
      vSetCPUType = CPU32Bit
      vSetSizeOfEnum = Size32Bit
      vSetSizeOfInt = Size32Bit
    vSetCalibration
