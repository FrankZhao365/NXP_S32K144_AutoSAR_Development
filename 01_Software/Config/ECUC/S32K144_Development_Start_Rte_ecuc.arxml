AUTOSAR XML (schema 4-2-1)
package /ActiveEcuC
  module config Rte: implementation-config-variant=VARIANT-PRE-COMPILE, module-description=Rte_Impl
    RteOsInteraction
      3 x RteUsedOsActivation, all with RteExpectedActivationOffset=0, RteExpectedTickDuration=0:
        Rte_Al_TE2_OsTask_BSW_SCHM_0_10ms: RteActivationOsAlarmRef=Rte_Al_TE2_OsTask_BSW_SCHM_0_10ms, RteActivationOsTaskRef=OsTask_BSW_SCHM
        Rte_Al_TE_Ct_LedCtrl_LedCtrl_Runnable: RteActivationOsAlarmRef=Rte_Al_TE_Ct_LedCtrl_LedCtrl_Runnable, RteActivationOsTaskRef=OsTask_APP
        Rte_Al_TE2_OsTask_BSW_SCHM_0_20ms: RteActivationOsAlarmRef=Rte_Al_TE2_OsTask_BSW_SCHM_0_20ms, RteActivationOsTaskRef=OsTask_BSW_SCHM
    RteGeneration:
      RteGenerationMode = COMPATIBILITY_MODE
      RteIocInteractionReturnValue = RTE_IOC
      RteValueRangeCheckEnabled = false
      RteCalibrationSupport = NONE
      RteCodeVendorId = 30
      RteDevErrorDetect = false
      RteDevErrorDetectUninit = false
      RteMeasurementSupport = false
      RteOptimizationMode = MEMORY
      RteVfbTraceEnabled = false
    RteInitializationBehavior: RteInitializationStrategy=RTE_INITIALIZATION_STRATEGY_AT_DATA_DECLARATION, RteSectionInitializationPolicy=INIT
    RteBswGeneral: RteSchMVersionInfoApi=false, RteUseComShadowSignalApi=false
    4 x RteBswModuleInstance:
      Mcu: RteBswImplementationRef=Mcu_Impl, RteBswModuleConfigurationRef=Mcu
        31 x RteBswExclusiveAreaImpl, all with RteExclusiveAreaImplMechanism=ALL_INTERRUPT_BLOCKING:
          MCU_EXCLUSIVE_AREA_{00..30}: RteBswExclusiveAreaRef=MCU_EXCLUSIVE_AREA_{00..30}
      Dio: RteBswImplementationRef=Dio_Impl, RteBswModuleConfigurationRef=Dio
        31 x RteBswExclusiveAreaImpl, all with RteExclusiveAreaImplMechanism=ALL_INTERRUPT_BLOCKING:
          DIO_EXCLUSIVE_AREA_{00..30}: RteBswExclusiveAreaRef=DIO_EXCLUSIVE_AREA_{00..30}
      Port: RteBswImplementationRef=Port_Impl, RteBswModuleConfigurationRef=Port
        31 x RteBswExclusiveAreaImpl, all with RteExclusiveAreaImplMechanism=ALL_INTERRUPT_BLOCKING:
          PORT_EXCLUSIVE_AREA_{00..30}: RteBswExclusiveAreaRef=PORT_EXCLUSIVE_AREA_{00..30}
      BswM: RteBswImplementationRef=BswM_Impl, RteBswModuleConfigurationRef=BswM
        BswM_MainFunctionTimingEvent0 (RteBswEventToTaskMapping):
          RteBswImmediateRestart = false
          RteBswPositionInTask = 1
          RteBswEventRef = BswM_MainFunctionTimingEvent0
          RteBswMappedToTaskRef = OsTask_BSW_SCHM
          RteBswUsedOsEventRef = Rte_Ev_Cyclic2_OsTask_BSW_SCHM_0_10ms
          RteBswUsedOsAlarmRef = Rte_Al_TE2_OsTask_BSW_SCHM_0_10ms
        BSWM_EXCLUSIVE_AREA_0 (RteBswExclusiveAreaImpl): RteExclusiveAreaImplMechanism=ALL_INTERRUPT_BLOCKING, RteBswExclusiveAreaRef=BSWM_EXCLUSIVE_AREA_0
    4 x RteSwComponentInstance:
      BswM_EcuSwComposition: RteSoftwareComponentInstanceRef=BswM
        Timer_BswM_MainFunction (RteEventToTaskMapping):
          RteImmediateRestart = false
          RtePositionInTask = 1
          RteEventRef = Timer_BswM_MainFunction
          RteMappedToTaskRef = OsTask_BSW_SCHM
          RteUsedOsEventRef = Rte_Ev_Cyclic2_OsTask_BSW_SCHM_0_10ms
          RteUsedOsAlarmRef = Rte_Al_TE2_OsTask_BSW_SCHM_0_10ms
      Det_EcuSwComposition: RteSoftwareComponentInstanceRef=Det
      EcuM_EcuSwComposition: RteSoftwareComponentInstanceRef=EcuM
        8 x RteEventToTaskMapping, all with RteImmediateRestart=false:
          Timer_EcuM_MainFunction: RtePositionInTask=0, RteEventRef=Timer_EcuM_MainFunction, RteMappedToTaskRef=OsTask_BSW_SCHM, RteUsedOsEventRef=Rte_Ev_Cyclic2_OsTask_BSW_SCHM_0_10ms, RteUsedOsAlarmRef=Rte_Al_TE2_OsTask_BSW_SCHM_0_10ms
          OpEventSelectShutdownTarget_SelectShutdownTarget_EcuM_ShutdownTarget: RteEventRef=OpEventSelectShutdownTarget_SelectShutdownTarget_EcuM_ShutdownTarget
          OpEventGetShutdownTarget_GetShutdownTarget_EcuM_ShutdownTarget: RteEventRef=OpEventGetShutdownTarget_GetShutdownTarget_EcuM_ShutdownTarget
          OpEventGetLastShutdownTarget_GetLastShutdownTarget_EcuM_ShutdownTarget: RteEventRef=OpEventGetLastShutdownTarget_GetLastShutdownTarget_EcuM_ShutdownTarget
          OpEventSelectShutdownCause_SelectShutdownCause_EcuM_ShutdownTarget: RteEventRef=OpEventSelectShutdownCause_SelectShutdownCause_EcuM_ShutdownTarget
          OpEventGetShutdownCause_GetShutdownCause_EcuM_ShutdownTarget: RteEventRef=OpEventGetShutdownCause_GetShutdownCause_EcuM_ShutdownTarget
          OpEventSelectBootTarget_SelectBootTarget_EcuM_BootTarget: RteEventRef=OpEventSelectBootTarget_SelectBootTarget_EcuM_BootTarget
          OpEventGetBootTarget_GetBootTarget_EcuM_BootTarget: RteEventRef=OpEventGetBootTarget_GetBootTarget_EcuM_BootTarget
      Os_OsCore0_swc_EcuSwComposition: RteSoftwareComponentInstanceRef=Os_OsCore0_swc
        OpEventGetCounterValue_GetCounterValue_OsService_SystemTimer (RteEventToTaskMapping): RteImmediateRestart=false, RteEventRef=OpEventGetCounterValue_GetCounterValue_OsService_SystemTimer
        OpEventGetElapsedValue_GetElapsedValue_OsService_SystemTimer (RteEventToTaskMapping): RteImmediateRestart=false, RteEventRef=OpEventGetElapsedValue_GetElapsedValue_OsService_SystemTimer
    3 x RteBswModuleInstance:
      Rte: RteBswImplementationRef=Rte_Impl, RteBswModuleConfigurationRef=Rte
      Det: RteBswImplementationRef=Det_Impl, RteBswModuleConfigurationRef=Det
        DET_EXCLUSIVE_AREA_0 (RteBswExclusiveAreaImpl): RteExclusiveAreaImplMechanism=ALL_INTERRUPT_BLOCKING, RteBswExclusiveAreaRef=DET_EXCLUSIVE_AREA_0
      EcuM: RteBswImplementationRef=EcuM_Impl, RteBswModuleConfigurationRef=EcuM
        EcuM_MainFunctionTimingEvent0 (RteBswEventToTaskMapping):
          RteBswImmediateRestart = false
          RteBswPositionInTask = 0
          RteBswEventRef = EcuM_MainFunctionTimingEvent0
          RteBswMappedToTaskRef = OsTask_BSW_SCHM
          RteBswUsedOsEventRef = Rte_Ev_Cyclic2_OsTask_BSW_SCHM_0_10ms
          RteBswUsedOsAlarmRef = Rte_Al_TE2_OsTask_BSW_SCHM_0_10ms
        3 x RteBswExclusiveAreaImpl, all with RteExclusiveAreaImplMechanism=ALL_INTERRUPT_BLOCKING:
          ECUM_EXCLUSIVE_AREA_{0..2}: RteBswExclusiveAreaRef=ECUM_EXCLUSIVE_AREA_{0..2}
    Ct_LedCtrl_EcuSwComposition (RteSwComponentInstance): RteSoftwareComponentInstanceRef=Ct_LedCtrl
      TMT_LedCtrl_Runnable (RteEventToTaskMapping):
        RteImmediateRestart = false
        RtePositionInTask = 1
        RteEventRef = TMT_LedCtrl_Runnable
        RteMappedToTaskRef = OsTask_APP
        RteUsedOsEventRef = Rte_Ev_Run_Ct_LedCtrl_LedCtrl_Runnable
        RteUsedOsAlarmRef = Rte_Al_TE_Ct_LedCtrl_LedCtrl_Runnable
      Ct_LEDCtrl_InitEvent (RteEventToTaskMapping): RteImmediateRestart=false, RtePositionInTask=0, RteEventRef=Ct_LEDCtrl_InitEvent, RteMappedToTaskRef=OsTask_APP
    Ct_LEDCtrl (RteSwComponentType): RteComponentTypeRef=Ct_LEDCtrl, RteImplementationRef=Ct_LEDCtrl_Implementation
      ComponentTypeCalibration (RteComponentTypeCalibration): RteCalibrationSupportEnabled=false
    ComM_EcuSwComposition (RteSwComponentInstance): RteSoftwareComponentInstanceRef=ComM
      13 x RteEventToTaskMapping, all with RteImmediateRestart=false:
        Timer_ComM_MainFunction_0: RtePositionInTask=9, RteEventRef=Timer_ComM_MainFunction_0, RteMappedToTaskRef=OsTask_BSW_SCHM, RteUsedOsEventRef=Rte_Ev_Cyclic2_OsTask_BSW_SCHM_0_20ms, RteUsedOsAlarmRef=Rte_Al_TE2_OsTask_BSW_SCHM_0_20ms
        OpEventGetInhibitionStatus_GetInhibitionStatus_CL_CN_CAN00_5e566ad9: RteEventRef=OpEventGetInhibitionStatus_GetInhibitionStatus_CL_CN_CAN00_5e566ad9
        OpEventGetInhibitionStatus_GetInhibitionStatus_CW_CN_CAN00_5e566ad9: RteEventRef=OpEventGetInhibitionStatus_GetInhibitionStatus_CW_CN_CAN00_5e566ad9
        OpEventLimitECUToNoComMode_LimitECUToNoComMode_modeLimitation: RteEventRef=OpEventLimitECUToNoComMode_LimitECUToNoComMode_modeLimitation
        OpEventReadInhibitCounter_ReadInhibitCounter_modeLimitation: RteEventRef=OpEventReadInhibitCounter_ReadInhibitCounter_modeLimitation
        OpEventResetInhibitCounter_ResetInhibitCounter_modeLimitation: RteEventRef=OpEventResetInhibitCounter_ResetInhibitCounter_modeLimitation
        OpEventSetECUGroupClassification_SetECUGroupClassification_modeLimitation: RteEventRef=OpEventSetECUGroupClassification_SetECUGroupClassification_modeLimitation
        OpEventLimitChannelToNoComMode_LimitChannelToNoComMode_CL_CN_CAN00_5e566ad9: RteEventRef=OpEventLimitChannelToNoComMode_LimitChannelToNoComMode_CL_CN_CAN00_5e566ad9
        OpEventPreventWakeUp_PreventWakeUp_CW_CN_CAN00_5e566ad9: RteEventRef=OpEventPreventWakeUp_PreventWakeUp_CW_CN_CAN00_5e566ad9
        OpEventRequestComMode_RequestComMode_UR_CN_CAN00_06ecbb07: RteEventRef=OpEventRequestComMode_RequestComMode_UR_CN_CAN00_06ecbb07
        OpEventGetCurrentComMode_GetCurrentComMode_UR_CN_CAN00_06ecbb07: RteEventRef=OpEventGetCurrentComMode_GetCurrentComMode_UR_CN_CAN00_06ecbb07
        OpEventGetMaxComMode_GetMaxComMode_UR_CN_CAN00_06ecbb07: RteEventRef=OpEventGetMaxComMode_GetMaxComMode_UR_CN_CAN00_06ecbb07
        OpEventGetRequestedComMode_GetRequestedComMode_UR_CN_CAN00_06ecbb07: RteEventRef=OpEventGetRequestedComMode_GetRequestedComMode_UR_CN_CAN00_06ecbb07
    6 x RteBswModuleInstance:
      Can: RteBswImplementationRef=Can_Impl, RteBswModuleConfigurationRef=Can
        3 x RteBswEventToTaskMapping, all with RteBswImmediateRestart=false, RteBswMappedToTaskRef=OsTask_BSW_SCHM, RteBswUsedOsEventRef=Rte_Ev_Cyclic2_OsTask_BSW_SCHM_0_10ms, RteBswUsedOsAlarmRef=Rte_Al_TE2_OsTask_BSW_SCHM_0_10ms:
          Can_MainFunction_BusOffTimingEvent0: RteBswPositionInTask=2, RteBswEventRef=Can_MainFunction_BusOffTimingEvent0
          Can_MainFunction_WakeupTimingEvent0: RteBswPositionInTask=4, RteBswEventRef=Can_MainFunction_WakeupTimingEvent0
          Can_MainFunction_ModeTimingEvent0: RteBswPositionInTask=3, RteBswEventRef=Can_MainFunction_ModeTimingEvent0
        7 x RteBswExclusiveAreaImpl:
          CAN_EXCLUSIVE_AREA_{0..5}: RteExclusiveAreaImplMechanism=ALL_INTERRUPT_BLOCKING, RteBswExclusiveAreaRef=CAN_EXCLUSIVE_AREA_{0..5}
          CAN_EXCLUSIVE_AREA_6: RteExclusiveAreaImplMechanism=CUSTOM, RteBswExclusiveAreaRef=CAN_EXCLUSIVE_AREA_6
      CanIf: RteBswImplementationRef=CanIf_Impl, RteBswModuleConfigurationRef=CanIf
        8 x RteBswExclusiveAreaImpl:
          CANIF_EXCLUSIVE_AREA_0: RteExclusiveAreaImplMechanism=CUSTOM, RteBswExclusiveAreaRef=CANIF_EXCLUSIVE_AREA_0
          CANIF_EXCLUSIVE_AREA_{1..7}: RteExclusiveAreaImplMechanism=ALL_INTERRUPT_BLOCKING, RteBswExclusiveAreaRef=CANIF_EXCLUSIVE_AREA_{1..7}
      CanSM: RteBswImplementationRef=CanSM_Impl, RteBswModuleConfigurationRef=CanSM
        CanSM_MainFunctionTimingEvent0 (RteBswEventToTaskMapping):
          RteBswImmediateRestart = false
          RteBswPositionInTask = 5
          RteBswEventRef = CanSM_MainFunctionTimingEvent0
          RteBswMappedToTaskRef = OsTask_BSW_SCHM
          RteBswUsedOsEventRef = Rte_Ev_Cyclic2_OsTask_BSW_SCHM_0_10ms
          RteBswUsedOsAlarmRef = Rte_Al_TE2_OsTask_BSW_SCHM_0_10ms
        6 x RteBswExclusiveAreaImpl:
          CANSM_EXCLUSIVE_AREA_1: RteExclusiveAreaImplMechanism=CUSTOM, RteBswExclusiveAreaRef=CANSM_EXCLUSIVE_AREA_1
          CANSM_EXCLUSIVE_AREA_{2..6}: RteExclusiveAreaImplMechanism=ALL_INTERRUPT_BLOCKING, RteBswExclusiveAreaRef=CANSM_EXCLUSIVE_AREA_{2..6}
      Com: RteBswImplementationRef=Com_Impl, RteBswModuleConfigurationRef=Com
        Com_MainFunctionTxTimingEvent0 (RteBswEventToTaskMapping):
          RteBswImmediateRestart = false
          RteBswPositionInTask = 8
          RteBswEventRef = Com_MainFunctionTxTimingEvent0
          RteBswMappedToTaskRef = OsTask_BSW_SCHM
          RteBswUsedOsEventRef = Rte_Ev_Cyclic2_OsTask_BSW_SCHM_0_10ms
          RteBswUsedOsAlarmRef = Rte_Al_TE2_OsTask_BSW_SCHM_0_10ms
        Com_MainFunctionRxTimingEvent0 (RteBswEventToTaskMapping):
          RteBswImmediateRestart = false
          RteBswPositionInTask = 7
          RteBswEventRef = Com_MainFunctionRxTimingEvent0
          RteBswMappedToTaskRef = OsTask_BSW_SCHM
          RteBswUsedOsEventRef = Rte_Ev_Cyclic2_OsTask_BSW_SCHM_0_10ms
          RteBswUsedOsAlarmRef = Rte_Al_TE2_OsTask_BSW_SCHM_0_10ms
        3 x RteBswExclusiveAreaImpl, all with RteExclusiveAreaImplMechanism=ALL_INTERRUPT_BLOCKING:
          COM_EXCLUSIVE_AREA_TX: RteBswExclusiveAreaRef=COM_EXCLUSIVE_AREA_TX
          COM_EXCLUSIVE_AREA_RX: RteBswExclusiveAreaRef=COM_EXCLUSIVE_AREA_RX
          COM_EXCLUSIVE_AREA_BOTH: RteBswExclusiveAreaRef=COM_EXCLUSIVE_AREA_BOTH
      ComM: RteBswImplementationRef=ComM_Impl, RteBswModuleConfigurationRef=ComM
        ComM_MainFunction_0TimingEvent0 (RteBswEventToTaskMapping):
          RteBswImmediateRestart = false
          RteBswPositionInTask = 9
          RteBswEventRef = ComM_MainFunction_0TimingEvent0
          RteBswMappedToTaskRef = OsTask_BSW_SCHM
          RteBswUsedOsEventRef = Rte_Ev_Cyclic2_OsTask_BSW_SCHM_0_20ms
          RteBswUsedOsAlarmRef = Rte_Al_TE2_OsTask_BSW_SCHM_0_20ms
        COMM_EXCLUSIVE_AREA_0 (RteBswExclusiveAreaImpl): RteExclusiveAreaImplMechanism=ALL_INTERRUPT_BLOCKING, RteBswExclusiveAreaRef=COMM_EXCLUSIVE_AREA_0
        COMM_EXCLUSIVE_AREA_1 (RteBswExclusiveAreaImpl): RteExclusiveAreaImplMechanism=CUSTOM, RteBswExclusiveAreaRef=COMM_EXCLUSIVE_AREA_1
      PduR: RteBswImplementationRef=PduR_Impl, RteBswModuleConfigurationRef=PduR
        PDUR_EXCLUSIVE_AREA_0 (RteBswExclusiveAreaImpl): RteExclusiveAreaImplMechanism=ALL_INTERRUPT_BLOCKING, RteBswExclusiveAreaRef=PDUR_EXCLUSIVE_AREA_0
