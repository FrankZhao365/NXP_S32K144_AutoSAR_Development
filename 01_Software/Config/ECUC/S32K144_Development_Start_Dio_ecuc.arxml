AUTOSAR XML (schema 4-2-1)
package /Dio
  module config Dio: implementation-config-variant=VARIANT-PRE-COMPILE, module-description=Dio_Impl
    CommonPublishedInformation:
      ArReleaseMajorVersion = 4
      ArReleaseMinorVersion = 2
      ArReleaseRevisionVersion = 2
      ModuleId = 120
      SwMajorVersion = 1
      SwMinorVersion = 0
      SwPatchVersion = 1
      VendorId = 43
    DioConfig
      5 x DioPort:
        DioPort_PortA: DioPortId=0
        DioPort_PortB: DioPortId=1
        DioPort_PortC: DioPortId=2
        DioPort_PortD: DioPortId=3
          4 x DioChannel:
            DioChannel_LEDB_4_PTD0_P4: DioChannelId=0
            DioChannel_LEDR_2_PTD15_P22: DioChannelId=15
            DioChannel_LEDY_3_PTD1_P3: DioChannelId=1
            DioChannel__LEDG_1_PTD16_P21: DioChannelId=16
        DioPort_PortE: DioPortId=4
    DioGeneral:
      DioDevErrorDetect = true
      DioEnableUserModeSupport = false
      DioFlipChannelApi = false
      DioMaskedWritePortApi = false
      DioReadZeroForUndefinedPortPins = false
      DioReversePortBits = false
      DioVersionInfoApi = false
