AUTOSAR XML (schema 4-2-1)
package /COM/VECTOR/CFG/WORKFLOW/SYSDESC/SYNC
  flat map FLATMAP
    flat instance descriptor Ct_LedCtrl: upstream-reference=EcuSwComposition.Ct_LedCtrl, ecu-extract-reference=COMPOSITIONTYPE.Ct_LedCtrl
