AUTOSAR XML (schema 00044)
package /ECUCompositionTypes
  composition sw component type ECU_Composition
    component Ct_LedCtrl: type=Ct_LEDCtrl
package /EndToEndProtections
  end to end protection set EndToEndProtectionSet
package /Systems
  system S32K144_Development_Start
    root-software-compositions:
      root sw composition prototype EcuSwComposition: software-composition=ECU_Composition
