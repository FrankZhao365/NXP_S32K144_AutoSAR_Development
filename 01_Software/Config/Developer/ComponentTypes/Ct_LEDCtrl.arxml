AUTOSAR XML (schema 00044)
package /ComponentTypes
  application sw component type Ct_LEDCtrl
    behavior Ct_LEDCtrl_InternalBehavior
      timing event TMT_LedCtrl_Runnable: start-on-event=LedCtrl_Runnable, period=0.5
      init event Ct_LEDCtrl_InitEvent: start-on-event=Ct_LEDCtrl_Init
      runnable LedCtrl_Runnable
      runnable Ct_LEDCtrl_Init
  swc implementation Ct_LEDCtrl_Implementation: behavior=Ct_LEDCtrl_InternalBehavior
