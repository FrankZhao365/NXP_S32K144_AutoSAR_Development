AUTOSAR XML (schema 4-2-2)
package /Resource
  module config Resource
    CommonPublishedInformation:
      ArReleaseMajorVersion = 4
      ArReleaseMinorVersion = 2
      ArReleaseRevisionVersion = 2
      ModuleId = 0
      SwMajorVersion = 1
      SwMinorVersion = 0
      SwPatchVersion = 1
      VendorId = 43
    ResourceGeneral: ResourceSubderivative=s32k144_lqfp100
package /Base
  module config Base
    CommonPublishedInformation:
      ArReleaseMajorVersion = 4
      ArReleaseMinorVersion = 2
      ArReleaseRevisionVersion = 2
      ModuleId = 0
      SwMajorVersion = 1
      SwMinorVersion = 0
      SwPatchVersion = 1
      VendorId = 43
package /Port
  module config Port: implementation-config-variant=VARIANT-POST-BUILD
    CommonPublishedInformation:
      ArReleaseMajorVersion = 4
      ArReleaseMinorVersion = 2
      ArReleaseRevisionVersion = 2
      ModuleId = 124
      SwMajorVersion = 1
      SwMinorVersion = 0
      SwPatchVersion = 1
      VendorId = 43
    PortConfigSet
      NotUsedPortPin: PortPinDSE=Low_Drive_Strength, PortPinDirection=PORT_PIN_IN, PortPinLevelValue=PORT_PIN_LEVEL_LOW, PortPinPE=PullDisabled, PortPinPS=PullDown
      4 x PortContainer:
        PortContainer_CAN0: PortNumberOfPortPins=2
          PortPin_PTE4_CAN0_RX (PortPin):
            PortPinDSE = Low_drive_strength
            PortPinDirection = PORT_PIN_IN
            PortPinDirectionChangeable = 1
            PortPinId = 11
            PortPinInitialMode = PORT_GPIO_MODE
            PortPinLevelValue = PORT_PIN_LEVEL_LOW
            PortPinMode = CAN0_RX
            PortPinModeChangeable = 1
            PortPinPE = PullDisabled
            PortPinPFE = 0
            PortPinPS = PullDown
            PortPinPcr = 132
          PortPin_PTE5_CAN0_TX (PortPin):
            PortPinDSE = Low_drive_strength
            PortPinDirection = PORT_PIN_OUT
            PortPinDirectionChangeable = 1
            PortPinId = 12
            PortPinInitialMode = PORT_GPIO_MODE
            PortPinLevelValue = PORT_PIN_LEVEL_LOW
            PortPinMode = CAN0_TX
            PortPinModeChangeable = 1
            PortPinPE = PullDisabled
            PortPinPFE = 0
            PortPinPS = PullDown
            PortPinPcr = 133
        PortContainer_CAN1: PortNumberOfPortPins=2
          PortPin_PTA12_CAN1_RX (PortPin):
            PortPinDSE = Low_drive_strength
            PortPinDirection = PORT_PIN_IN
            PortPinDirectionChangeable = 1
            PortPinId = 9
            PortPinInitialMode = PORT_GPIO_MODE
            PortPinLevelValue = PORT_PIN_LEVEL_LOW
            PortPinMode = CAN1_RX
            PortPinModeChangeable = 1
            PortPinPE = PullDisabled
            PortPinPFE = 0
            PortPinPS = PullDown
            PortPinPcr = 12
          PortPin_PTA13_CAN1_TX (PortPin):
            PortPinDSE = Low_drive_strength
            PortPinDirection = PORT_PIN_OUT
            PortPinDirectionChangeable = 1
            PortPinId = 10
            PortPinInitialMode = PORT_GPIO_MODE
            PortPinLevelValue = PORT_PIN_LEVEL_LOW
            PortPinMode = CAN1_TX
            PortPinModeChangeable = 1
            PortPinPE = PullDisabled
            PortPinPFE = 0
            PortPinPS = PullDown
            PortPinPcr = 13
        PortContainer_JTAG: PortNumberOfPortPins=4
          4 x PortPin, all with PortPinDSE=Low_drive_strength, PortPinDirectionChangeable=1, PortPinInitialMode=PORT_GPIO_MODE, PortPinLevelValue=PORT_PIN_LEVEL_LOW, PortPinModeChangeable=1, PortPinPFE=0:
            PortPin_JTAG_TCLK_PTC4: PortPinDirection=PORT_PIN_IN, PortPinId=7, PortPinMode=JTAG_TCLK_SWD_CLK, PortPinPE=PullEnabled, PortPinPS=PullUp, PortPinPcr=68
            PortPin_JTAG_TDI_PTC5: PortPinDirection=PORT_PIN_IN, PortPinId=5, PortPinMode=JTAG_TDI, PortPinPE=PullEnabled, PortPinPS=PullUp, PortPinPcr=69
            PortPin_JTAG_TDO_PTA10: PortPinDirection=PORT_PIN_OUT, PortPinId=8, PortPinMode=JTAG_TDO, PortPinPE=PullDisabled, PortPinPS=PullDown, PortPinPcr=10
            PortPin_JTAG_TMS_PTA4: PortPinDirection=PORT_PIN_IN, PortPinId=6, PortPinMode=JTAG_TMS_SWD_DIO, PortPinPE=PullEnabled, PortPinPS=PullUp, PortPinPcr=4
        PortContainer_LED: PortNumberOfPortPins=4
          4 x PortPin, all with PortPinDSE=Low_drive_strength, PortPinDirection=PORT_PIN_OUT, PortPinDirectionChangeable=1, PortPinInitialMode=PORT_GPIO_MODE, PortPinLevelValue=PORT_PIN_LEVEL_LOW, PortPinMode=GPIO, PortPinModeChangeable=1, PortPinPE=PullDisabled, PortPinPFE=0, PortPinPS=PullDown:
            PortPin_LEDB_4_PTD0_P4: PortPinId=1, PortPinPcr=96
            PortPin_LEDG_1_PTD16_P21: PortPinId=4, PortPinPcr=112
            PortPin_LEDR_2_PTD15_P22: PortPinId=3, PortPinPcr=111
            PortPin_LEDY_3_PTD1_P3: PortPinId=2, PortPinPcr=97
    PortGeneral:
      PortDevErrorDetect = 1
      PortEnableUserModeSupport = 0
      PortSet2PinsDirectionApi = 0
      PortSetPinDirectionApi = 1
      PortSetPinModeApi = 1
      PortSetPinModeDoesNotTouchGpioLevel = 0
      PortVersionInfoApi = 1
package /Dio
  module config Dio: implementation-config-variant=VARIANT-PRE-COMPILE
    CommonPublishedInformation:
      ArReleaseMajorVersion = 4
      ArReleaseMinorVersion = 2
      ArReleaseRevisionVersion = 2
      ModuleId = 120
      SwMajorVersion = 1
      SwMinorVersion = 0
      SwPatchVersion = 1
      VendorId = 43
    DioConfig
      5 x DioPort:
        DioPort_PortA: DioPortId=0
        DioPort_PortB: DioPortId=1
        DioPort_PortC: DioPortId=2
        DioPort_PortD: DioPortId=3
          4 x DioChannel:
            DioChannel_LEDB_4_PTD0_P4: DioChannelId=0
            DioChannel_LEDR_2_PTD15_P22: DioChannelId=15
            DioChannel_LEDY_3_PTD1_P3: DioChannelId=1
            DioChannel__LEDG_1_PTD16_P21: DioChannelId=16
        DioPort_PortE: DioPortId=4
    DioGeneral:
      DioDevErrorDetect = 1
      DioEnableUserModeSupport = 0
      DioFlipChannelApi = 0
      DioMaskedWritePortApi = 0
      DioReadZeroForUndefinedPortPins = 0
      DioReversePortBits = 0
      DioVersionInfoApi = 0
package /Mcu
  module config Mcu: implementation-config-variant=VARIANT-POST-BUILD
    CommonPublishedInformation:
      ArReleaseMajorVersion = 4
      ArReleaseMinorVersion = 2
      ArReleaseRevisionVersion = 2
      ModuleId = 101
      SwMajorVersion = 1
      SwMinorVersion = 0
      SwPatchVersion = 1
      VendorApiInfix = 
      VendorId = 43
    McuDebugConfiguration: McuDisableCmuApi=0, McuDisableDemReportErrorStatus=0, McuEnablePeripheralCMU=0, McuGetMidrStructureApi=0, McuGetPeriphStateApi=0
    McuGeneralConfiguration:
      McuCalloutBeforePerformReset = 0
      McuDevErrorDetect = 1
      McuEnableUserModeSupport = 0
      McuEnterLowPowerMode = 1
      McuGetRamStateApi = 0
      McuInitClock = 1
      McuNoPll = 0
      McuPerformResetApi = 0
      McuPerformResetCallout = NULL_PTR
      McuTimeout = 50000
      McuVersionInfoApi = 0
    McuModuleConfiguration:
      McuClockSrcFailureNotification = ENABLED
      McuLPO1KClockEnable = 1
      McuLPO32KClockEnable = 1
      McuLPOClockSelect = LPO_CLK_128K
      McuNumberOfMcuModes = 1
      McuRTCCLKINFrequencyHz = 32000.0
      McuRamSectors = 0
      McuRtcClkSelect = SOSCDIV1_CLK
      McuAllowedModes: McuAllowHighSpeedRunMode=1, McuAllowVeryLowPowerModes=1
      McuClockSettingConfig_0 (McuClockSettingConfig): McuClockSettingId=0, McuScgClkOutSelect=SCG_SLOW_CLK, McuSysClockUnderMcuControl=1
        McuClkMonitor_0:
          McuClkMonitorEn = 0
          McuFrequencyHigherInterrupt = 0
          McuFrequencyLowerInterrupt = 0
          McuHighFrequencyRef = 16777215
          McuLowFrequencyRef = 0
          McuReferenceCountConfiguration = 65535
        McuClkMonitor_1:
          McuClkMonitorEn = 0
          McuFrequencyHigherInterrupt = 0
          McuFrequencyLowerInterrupt = 0
          McuHighFrequencyRef = 16777215
          McuLowFrequencyRef = 0
          McuReferenceCountConfiguration = 65535
        McuClockReferencePoint_0 (McuClockReferencePoint): McuClockFrequencySelect=RUN_SYS_CLK, McuClockReferencePointFrequency=8.0E7
        McuFIRCClockConfig:
          McuFIRCDiv1 = 1
          McuFIRCDiv1Frequency = 4.8E7
          McuFIRCDiv2 = 2
          McuFIRCDiv2Frequency = 2.4E7
          McuFIRCEnable = 1
          McuFIRCFrequency = 4.8E7
          McuFIRCRangeSelect = TRIMMED_TO_48MHZ
          McuFIRCRegulatorEnable = 0
          McuFIRCUnderMcuControl = 1
        McuHsrunClockConfig:
          McuBusClockDivider = 2
          McuBusClockFrequency = 4.0E7
          McuCoreClockDivider = 2
          McuCoreClockFrequency = 8.0E7
          McuFlashClockFrequency = 2.0E7
          McuPreDivSystemClockFrequency = 1.6E8
          McuScgClkOutFrequency = 2.0E7
          McuSlowClockDivider = 4
          McuSystemClockFrequency = 8.0E7
          McuSystemClockSwitch = SPLL
        32 x McuPeripheralClockConfig, all with McuPeripheralClockDivider=1, McuPeripheralClockEnable=1, McuPeripheralFractionalDivider=0:
          McuPeripheralClockConfig_0: McuPerName=FTFC, McuPeripheralClockFrequency=0.0, McuPeripheralClockSelect=EXT_CLK_OR_CLK_OFF
          McuPeripheralClockConfig_1: McuPerName=DMAMUX0, McuPeripheralClockFrequency=0.0, McuPeripheralClockSelect=EXT_CLK_OR_CLK_OFF
          McuPeripheralClockConfig_10: McuPerName=PDB1, McuPeripheralClockFrequency=0.0, McuPeripheralClockSelect=EXT_CLK_OR_CLK_OFF
          McuPeripheralClockConfig_11: McuPerName=CRC, McuPeripheralClockFrequency=0.0, McuPeripheralClockSelect=EXT_CLK_OR_CLK_OFF
          McuPeripheralClockConfig_12: McuPerName=PDB0, McuPeripheralClockFrequency=0.0, McuPeripheralClockSelect=EXT_CLK_OR_CLK_OFF
          McuPeripheralClockConfig_13: McuPerName=LPIT, McuPeripheralClockFrequency=0.0, McuPeripheralClockSelect=EXT_CLK_OR_CLK_OFF
          McuPeripheralClockConfig_14: McuPerName=FTM0, McuPeripheralClockFrequency=0.0, McuPeripheralClockSelect=EXT_CLK_OR_CLK_OFF
          McuPeripheralClockConfig_15: McuPerName=FTM1, McuPeripheralClockFrequency=0.0, McuPeripheralClockSelect=EXT_CLK_OR_CLK_OFF
          McuPeripheralClockConfig_16: McuPerName=FTM2, McuPeripheralClockFrequency=0.0, McuPeripheralClockSelect=EXT_CLK_OR_CLK_OFF
          McuPeripheralClockConfig_17: McuPerName=ADC0, McuPeripheralClockFrequency=0.0, McuPeripheralClockSelect=EXT_CLK_OR_CLK_OFF
          McuPeripheralClockConfig_18: McuPerName=RTC, McuPeripheralClockFrequency=0.0, McuPeripheralClockSelect=EXT_CLK_OR_CLK_OFF
          McuPeripheralClockConfig_19: McuPerName=LPTMR0, McuPeripheralClockFrequency=0.0, McuPeripheralClockSelect=EXT_CLK_OR_CLK_OFF
          McuPeripheralClockConfig_2: McuPerName=FLEXCAN0, McuPeripheralClockFrequency=0.0, McuPeripheralClockSelect=EXT_CLK_OR_CLK_OFF
          McuPeripheralClockConfig_20: McuPerName=PORTA, McuPeripheralClockFrequency=0.0, McuPeripheralClockSelect=EXT_CLK_OR_CLK_OFF
          McuPeripheralClockConfig_21: McuPerName=PORTB, McuPeripheralClockFrequency=0.0, McuPeripheralClockSelect=EXT_CLK_OR_CLK_OFF
          McuPeripheralClockConfig_22: McuPerName=PORTC, McuPeripheralClockFrequency=0.0, McuPeripheralClockSelect=EXT_CLK_OR_CLK_OFF
          McuPeripheralClockConfig_23: McuPerName=PORTD, McuPeripheralClockFrequency=0.0, McuPeripheralClockSelect=EXT_CLK_OR_CLK_OFF
          McuPeripheralClockConfig_24: McuPerName=PORTE, McuPeripheralClockFrequency=0.0, McuPeripheralClockSelect=EXT_CLK_OR_CLK_OFF
          McuPeripheralClockConfig_25: McuPerName=FLEXIO, McuPeripheralClockFrequency=0.0, McuPeripheralClockSelect=EXT_CLK_OR_CLK_OFF
          McuPeripheralClockConfig_26: McuPerName=EWM, McuPeripheralClockFrequency=0.0, McuPeripheralClockSelect=EXT_CLK_OR_CLK_OFF
          McuPeripheralClockConfig_27: McuPerName=LPI2C0, McuPeripheralClockFrequency=0.0, McuPeripheralClockSelect=EXT_CLK_OR_CLK_OFF
          McuPeripheralClockConfig_28: McuPerName=LPUART0, McuPeripheralClockFrequency=0.0, McuPeripheralClockSelect=EXT_CLK_OR_CLK_OFF
          McuPeripheralClockConfig_29: McuPerName=LPUART1, McuPeripheralClockFrequency=0.0, McuPeripheralClockSelect=EXT_CLK_OR_CLK_OFF
          McuPeripheralClockConfig_3: McuPerName=FLEXCAN1, McuPeripheralClockFrequency=0.0, McuPeripheralClockSelect=EXT_CLK_OR_CLK_OFF
          McuPeripheralClockConfig_30: McuPerName=LPUART2, McuPeripheralClockFrequency=0.0, McuPeripheralClockSelect=EXT_CLK_OR_CLK_OFF
          McuPeripheralClockConfig_31: McuPerName=CMP0, McuPeripheralClockFrequency=0.0, McuPeripheralClockSelect=EXT_CLK_OR_CLK_OFF
          McuPeripheralClockConfig_4: McuPerName=FTM3, McuPeripheralClockFrequency=0.0, McuPeripheralClockSelect=EXT_CLK_OR_CLK_OFF
          McuPeripheralClockConfig_5: McuPerName=ADC1, McuPeripheralClockFrequency=0.0, McuPeripheralClockSelect=EXT_CLK_OR_CLK_OFF
          McuPeripheralClockConfig_6: McuPerName=FLEXCAN2, McuPeripheralClockFrequency=0.0, McuPeripheralClockSelect=EXT_CLK_OR_CLK_OFF
          McuPeripheralClockConfig_7: McuPerName=LPSPI0, McuPeripheralClockFrequency=0.0, McuPeripheralClockSelect=EXT_CLK_OR_CLK_OFF
          McuPeripheralClockConfig_8: McuPerName=LPSPI1, McuPeripheralClockFrequency=4.0E7, McuPeripheralClockSelect=SPLL
          McuPeripheralClockConfig_9: McuPerName=LPSPI2, McuPeripheralClockFrequency=4.0E7, McuPeripheralClockSelect=SPLL
        McuRunClockConfig:
          McuBusClockDivider = 2
          McuBusClockFrequency = 4.0E7
          McuCoreClockDivider = 2
          McuCoreClockFrequency = 8.0E7
          McuFlashClockFrequency = 2.0E7
          McuPreDivSystemClockFrequency = 1.6E8
          McuScgClkOutFrequency = 2.0E7
          McuSlowClockDivider = 4
          McuSystemClockFrequency = 8.0E7
          McuSystemClockSwitch = SPLL
        McuSIMClockConfig:
          McuClockOutDivider = 1
          McuClockOutEnable = 0
          McuClockOutSelect = SCG_CLKOUT
          McuDMAClockGatingEnable = 1
          McuDebugTraceDividerEnable = 1
          McuEIMClockGatingEnable = 1
          McuERMClockGatingEnable = 1
          McuGPIOClockGatingEnable = 0
          McuMPUClockGatingEnable = 1
          McuMSCMClockGatingEnable = 1
          McuTraceClockDivider = 1
          McuTraceClockFraction = 0
          McuTraceClockSelect = CORE_CLK
        McuSIRCClockConfig:
          McuSIRCDiv1 = 1
          McuSIRCDiv1Frequency = 8000000.0
          McuSIRCDiv2 = 2
          McuSIRCDiv2Frequency = 4000000.0
          McuSIRCEnable = 1
          McuSIRCFrequency = 8000000.0
          McuSIRCLowPowerEnable = 0
          McuSIRCRangeSelect = HIGH_RANGE_CLOCK
          McuSIRCStopEnable = 0
          McuSIRCUnderMcuControl = 1
        McuSystemOSCClockConfig:
          McuSOSCClockMonitorEnable = 0
          McuSOSCClockMonitorResetEnable = 0
          McuSOSCDiv1 = 1
          McuSOSCDiv1Frequency = 8000000.0
          McuSOSCDiv2 = 2
          McuSOSCDiv2Frequency = 4000000.0
          McuSOSCEnable = 1
          McuSOSCExternalReferenceSelect = 0
          McuSOSCFrequency = 8000000.0
          McuSOSCHighGainOscillatorSelect = 0
          McuSOSCRangeSelect = HIGH_FREQ_RANGE
          McuSOSCUnderMcuControl = 1
        McuSystemPll:
          McuSPLLClockMonitorEnable = 0
          McuSPLLClockMonitorResetEnable = 0
          McuSPLLDiv1 = 4
          McuSPLLDiv1Frequency = 4.0E7
          McuSPLLDiv2 = 4
          McuSPLLDiv2Frequency = 4.0E7
          McuSPLLEnable = 1
          McuSPLLFrequency = 1.6E8
          McuSPLLInputClkPreDivider = 1
          McuSPLLInputFrequency = 8000000.0
          McuSPLLMultiplier = 40
          McuSystemPllUnderMcuControl = 0
        McuVlprClockConfig:
          McuBusClockDivider = 1
          McuBusClockFrequency = 4000000.0
          McuCoreClockDivider = 2
          McuCoreClockFrequency = 4000000.0
          McuFlashClockFrequency = 1000000.0
          McuPreDivSystemClockFrequency = 8000000.0
          McuScgClkOutFrequency = 1000000.0
          McuSlowClockDivider = 4
          McuSystemClockFrequency = 4000000.0
          McuSystemClockSwitch = SIRC
      McuInterruptEvents: McuAlternateResetEvent=0, McuVoltageErrorEvent=0
      McuModeSettingConf_0 (McuModeSettingConf): McuMode=0, McuPowerMode=RUN
      McuPowerControl:
        McuClockBiasDisable = 0
        McuLPODisable = 0
        McuLowPowerBiasEnable = 0
        McuLowVoltageDetectInterruptEnable = 0
        McuLowVoltageDetectResetEnable = 0
        McuLowVoltageWarningInterruptEnable = 0
        McuLpoTrimming = 0
      McuResetConfig: McuResetPinFilterBusClockSelect=0, McuResetPinFilterInRunAndWait=ALL_FILTERING_DISABLE, McuResetPinFilterInStopMode=ALL_FILTERING_DISABLE
        McuSystemInterruptEnable:
          McuCMULossOfClockResetInterrupt = 0
          McuCoreLockupInterrupt = 0
          McuExternalResetPinInterrupt = 0
          McuGlobalInterrupt = 0
          McuJTAGResetInterrupt = 0
          McuLossOfClockInterrupt = 0
          McuLossOfLockInterrupt = 0
          McuMDMAPSystemResetInterrupt = 0
          McuResetDelayTime = DELAY_10_LPO_CYCLES
          McuSoftwareInterrupt = 0
          McuStopAcknowledgeErrorInterrupt = 0
          McuWatchdogInterrupt = 0
      McuSIMConfig
        McuAdcOptionsConfiguration:
          McuADC0PreTrigeerSourceSelect = PDB_PRE_TRIGGER
          McuADC0SoftwarePreTrigeerSourceSelect = SW_PRE_TRIGGER_DISABLE
          McuADC0TrigeerSourceSelect = PDB
          McuADC1PreTrigeerSourceSelect = PDB_PRE_TRIGGER
          McuADC1SoftwarePreTrigeerSourceSelect = SW_PRE_TRIGGER_DISABLE
          McuADC1TrigeerSourceSelect = PDB
          McuSoftwareTriggerToTRGMUX = 0
        McuChipControlConfiguration:
          McuAdcSupply = VDD
          McuEnableAdcSupplyMonitoring = 0
          McuPDBBackToBackSelect = 0
          McuPTB0InterleaveChannelSelect = 0
          McuPTB13InterleaveChannelSelect = 0
          McuPTB14InterleaveChannelSelect = 0
          McuPTB1InterleaveChannelSelect = 0
        McuFlexTimerConfiguration:
          McuFTM0Ch{0..7}ModulationSelect = 0
          McuFTM0ExternalClockPinSelect = TCLK0_PIN
          McuFTM0Fault{0..2}Select = FTM0_FLT{0..2}_PIN
          McuFTM0OBEControl = 0
          McuFTM0SyncBit = 0
          McuFTM1Ch0InputSelect = FTM1_CH0_INPUT
          McuFTM1ExternalClockPinSelect = TCLK0_PIN
          McuFTM1Fault{0..2}Select = FTM1_FLT{0..2}_PIN
          McuFTM1OBEControl = 0
          McuFTM1SyncBit = 0
          McuFTM2Ch0InputSelect = FTM2_CH0_INPUT
          McuFTM2Ch1InputSelect = FTM2_CHI1_INPUT
          McuFTM2ExternalClockPinSelect = TCLK0_PIN
          McuFTM2Fault{0..2}Select = FTM2_FLT{0..2}_PIN
          McuFTM2OBEControl = 0
          McuFTM2SyncBit = 0
          McuFTM3Ch{0..7}ModulationSelect = 0
          McuFTM3ExternalClockPinSelect = TCLK0_PIN
          McuFTM3Fault{0..2}Select = FTM3_FLT{0..2}_PIN
          McuFTM3OBEControl = 0
          McuFTM3SyncBit = 0
          McuFTM4ExternalClockPinSelect = TCLK0_PIN
          McuFTM4OBEControl = 0
          McuFTM4SyncBit = 0
          McuFTM5ExternalClockPinSelect = TCLK0_PIN
          McuFTM5OBEControl = 0
          McuFTM5SyncBit = 0
          McuFTM6ExternalClockPinSelect = TCLK0_PIN
          McuFTM6OBEControl = 0
          McuFTM6SyncBit = 0
          McuFTM7ExternalClockPinSelect = TCLK0_PIN
          McuFTM7OBEControl = 0
          McuFTM7SyncBit = 0
          McuFTMGlobalLoadEnable = 0
          McuFTM_GTBControl = 0
          McuQspiClkSelect = 0
          McuRMII_ClkSelect = 0
          McuRMII_Clk_OBE = 0
    McuPublishedInformation
      15 x McuResetReasonConf:
        MCU_CMU_LOC_RESET: McuResetReason=14
        MCU_CORE_LOCKUP_RESET: McuResetReason=3
        MCU_EXTERNAL_PIN_RESET: McuResetReason=6
        MCU_JTAG_RESET: McuResetReason=4
        MCU_LOSS_OF_CLOCK_RESET: McuResetReason=9
        MCU_LOSS_OF_LOCK_RESET: McuResetReason=8
        MCU_LOW_OR_HIGH_VOLTAGE_DETECT_RESET: McuResetReason=10
        MCU_MDM_AP_SYSTEM_RESET: McuResetReason=1
        MCU_MULTIPLE_RESET_REASON: McuResetReason=12
        MCU_NO_RESET_REASON: McuResetReason=11
        MCU_POWER_ON_RESET: McuResetReason=5
        MCU_RESET_UNDEFINED: McuResetReason=13
        MCU_STOP_ACKNOWLEDGE_ERROR_RESET: McuResetReason=0
        MCU_SW_RESET: McuResetReason=2
        MCU_WATCHDOG_RESET: McuResetReason=7
