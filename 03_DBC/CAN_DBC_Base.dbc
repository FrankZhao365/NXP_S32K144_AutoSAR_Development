VERSION ""

NS_ :

BS_:

BU_: CAN1 CAN0
VAL_TABLE_ LightStatus 1 "ON" 0 "OFF" ;
VAL_TABLE_ SwitchStatus 1 "SwitchON" 0 "SwitchOFF" ;

BO_ 528 FrontLight: 8 CAN0
 SG_ FrontLightStatus : 1|1@1+ (1,0) [0|0] ""  CAN1
 SG_ FrontLightSW : 0|1@1+ (1,0) [0|0] ""  CAN1

BO_ 512 RearLight: 8 CAN0
 SG_ RearLightStatus : 1|1@1+ (1,0) [0|0] ""  CAN1
 SG_ RearLightSW : 0|1@1+ (1,0) [0|0] ""  CAN1

BA_DEF_ SG_  "GenSigSendType" ENUM  "Cycle","Write","vector_leerstring";
BA_DEF_ SG_  "GenSigILSupport" ENUM  "YES","NO";
BA_DEF_ BO_  "GenMsgSendType" ENUM  "Cycle","Event","vector_leerstring";
BA_DEF_ BO_  "GenMsgILSupport" ENUM  "YES","NO","vector_leerstring";
BA_DEF_  "BusType" STRING ;
BA_DEF_DEF_  "GenSigSendType" "Cycle";
BA_DEF_DEF_  "GenSigILSupport" "YES";
BA_DEF_DEF_  "GenMsgSendType" "Cycle";
BA_DEF_DEF_  "GenMsgILSupport" "YES";
BA_DEF_DEF_  "BusType" "CAN";
VAL_ 528 FrontLightStatus 1 "ON" 0 "OFF" ;
VAL_ 528 FrontLightSW 1 "SwitchON" 0 "SwitchOFF" ;
VAL_ 512 RearLightStatus 1 "ON" 0 "OFF" ;
VAL_ 512 RearLightSW 1 "SwitchON" 0 "SwitchOFF" ;
