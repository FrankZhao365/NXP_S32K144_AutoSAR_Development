VERSION ""

NS_ :

BS_:

BU_: CAN1 CAN0
VAL_TABLE_ LightStatus 1 "ON" 0 "OFF" ;
VAL_TABLE_ SwitchStatus 1 "SwitchON" 0 "SwitchOFF" ;

BO_ 528 FrontLight: 8 CAN0
 SG_ FrontLightStatus : 1|1@1+ (1,0) [0|0] ""  CAN1
 SG_ FrontLightSW : 0|1@1+ (1,0) [0|0] ""  CAN1

BO_ 512 RearLight: 8 CAN0
 SG_ RearLightStatus : 1|1@1+ (1,0) [0|0] ""  CAN1
 SG_ RearLightSW : 0|1@1+ (1,0) [0|0] ""  CAN1

BA_DEF_ BO_  "GenMsgSendType" ENUM  "cyclicX","spontanX","cyclicIfActiveX","spontanWithDelay","cyclicAndSpontanX","cyclicAndSpontanWithDelay","spontanWithRepetition","cyclicIfActiveAndSpontanWD","cyclicIfActiveFast","cyclicWithRepeatOnDemand";
BA_DEF_ SG_  "GenSigCycleTime" INT 0 0;
BA_DEF_ SG_  "GenSigSendType" ENUM  "cyclicX","spontanX","cyclicIfActiveX","spontanWithDelay","cyclicAndSpontanX","cyclicAndSpontanWithDelay","spontanWithRepetition","cyclicIfActiveAndSpontanWD","cyclicIfActiveFast","cyclicWithRepeatOnDemand","none","NotUsed","NotUsed";
BA_DEF_  "Baudrate" INT 0 1000000;
BA_DEF_  "Manufacturer" STRING ;
BA_DEF_  "NmAsrWaitBusSleepTime" INT 0 65535;
BA_DEF_  "NmAsrTimeoutTime" INT 0 65535;
BA_DEF_  "NmAsrRepeatMessageTime" INT 0 65535;
BA_DEF_ BU_  "NmAsrNode" ENUM  "no","yes";
BA_DEF_  "NmAsrMessageCount" INT 0 256;
BA_DEF_ BU_  "NmAsrCanMsgReducedTime" INT 0 65535;
BA_DEF_  "NmAsrCanMsgCycleTime" INT 0 65535;
BA_DEF_  "NmAsrBaseAddress" HEX 0 65535;
BA_DEF_ BU_  "ILUsed" ENUM  "no","yes";
BA_DEF_ BO_  "GenMsgILSupport" ENUM  "no","yes";
BA_DEF_DEF_  "GenMsgSendType" "cyclicX";
BA_DEF_DEF_  "GenSigCycleTime" 0;
BA_DEF_DEF_  "GenSigSendType" "cyclicX";
BA_DEF_DEF_  "Baudrate" 500000;
BA_DEF_DEF_  "Manufacturer" "Vector";
BA_DEF_DEF_  "NmAsrWaitBusSleepTime" 750;
BA_DEF_DEF_  "NmAsrTimeoutTime" 1000;
BA_DEF_DEF_  "NmAsrRepeatMessageTime" 400;
BA_DEF_DEF_  "NmAsrNode" "yes";
BA_DEF_DEF_  "NmAsrMessageCount" 64;
BA_DEF_DEF_  "NmAsrCanMsgReducedTime" 50;
BA_DEF_DEF_  "NmAsrCanMsgCycleTime" 100;
BA_DEF_DEF_  "NmAsrBaseAddress" 1024;
BA_DEF_DEF_  "ILUsed" "yes";
BA_DEF_DEF_  "GenMsgILSupport" "yes";
BA_ "GenSigCycleTime" SG_ 528 FrontLightStatus 100;
BA_ "GenSigCycleTime" SG_ 528 FrontLightSW 100;
BA_ "GenSigCycleTime" SG_ 512 RearLightStatus 100;
BA_ "GenSigCycleTime" SG_ 512 RearLightSW 100;
VAL_ 528 FrontLightStatus 1 "ON" 0 "OFF" ;
VAL_ 528 FrontLightSW 1 "SwitchON" 0 "SwitchOFF" ;
VAL_ 512 RearLightStatus 1 "ON" 0 "OFF" ;
VAL_ 512 RearLightSW 1 "SwitchON" 0 "SwitchOFF" ;
